/*
 * @Descripttion: Null
 * @version: 1.0
 * @Author: Mar Ping
 * @Date: 2019-12-22 01:00:12
 * @LastEditors  : Mar Ping
 * @LastEditTime : 2019-12-23 14:14:12
 */
/*
 * IRrecv-LED-Ctrl
 * =====================功能说明=====================
 * 演示如何利用Arduino开发板接收红外遥控器控制信号，
 * 并将接收到的红外遥控器信号用于控制Arduino内置LED。
 * 
 * 本程序基于Ken Shirriff开发的IRremote库。如需获得该库文件
 * 可前往以下网址获得：
 * http://arcfn.com （Ken Shirriff个人博客）                              
 * http://www.taichi-maker.com/homepage/download/  （太极创客官网）
 * 
 * =====================电路连接======================
 *   红外接收器 1838B OUT 引脚 ---  Arduino Uno 11  引脚 
 *   红外接收器 1838B VCC 引脚 ---  Arduino Uno +5V 引脚 
 *   红外接收器 1838B GND 引脚 ---  Arduino Uno GND 引脚 
 *         
 *  如需获得详细电路连接说明图，请参阅太极创客网站:
 *  http://WWW.TAICHI-MAKER.COM
 * 
 * 此示例程序为配合太极创客制作的
 * 《零基础入门学用ARDUINO教程-智能应用篇》使用
 * 
 */

#include <IRremote.h>
#include "U8glib.h"
U8GLIB_SSD1306_128X64 u8g(U8G_I2C_OPT_NONE); // I2C / TWI

int RECV_PIN = 11;
int LED = 12;
int LFD = 8;

//width:85,height:64 
static unsigned char pic1[] U8G_PROGMEM= {0xff,0xff,0xff,0xff,0xff,0xff,0xff,0x7f,0xe0,0x3d,0x00,0xff,0xff,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0x00,0x00}; 
static unsigned char pic2[] U8G_PROGMEM= {0x00,0x00,0x00,0x00,0xf8,0xf7,0xff,0xdf,0xf7,0xfe,0x3f,0x01,0x00,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0x00,0x00}; 
static unsigned char pic3[] U8G_PROGMEM= {0x00,0x00,0x00,0x00,0x00,0x00,0x00,0x00,0x00,0x00,0xfc,0xff,0x03,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0x00,0x00}; 
static unsigned char pic4[] U8G_PROGMEM= {0x00,0x00,0x00,0x00,0x00,0x00,0x00,0x00,0xcc,0xff,0x1f,0x00,0x00,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0xf7,0x1f}; 

IRrecv irrecv(RECV_PIN);

decode_results results;

void hello(void) 
{
  // graphic commands to redraw the complete screen should be placed here
  u8g.setFont(u8g_font_unifont);
  //u8g.setFont(u8g_font_osb21);
  u8g.drawStr( 2, 12, "Merry");
  u8g.drawStr( 35, 28, "Christmas!!!");
  u8g.drawXBMP(39,45,89,18,pic2); 
}

void pwer(int a) 
{
  // graphic commands to redraw the complete screen should be placed here
  u8g.setFont(u8g_font_unifont);
  //u8g.setFont(u8g_font_osb21);
  if(a==0)
  u8g.drawStr( 0, 44, "Power:ON");
  else
  u8g.drawStr( 0, 44, "Power:OFF");
}

void glib(char i)
{
  if(i=='n')
  {
    u8g.firstPage();

    do{
        hello();
        pwer(0);
    }while(u8g.nextPage());
  }
  else if(i=='f')
  {
    u8g.firstPage();

    do{
        hello();
        pwer(1);
    }while(u8g.nextPage());
  }
}

void setup()
{
    ///////////////////////////////////////////
    u8g.firstPage();

    do{
        u8g.drawXBMP(21,0,85,64,pic4); 
    }while(u8g.nextPage());
  ///////////////////////////////////////////
   delay(2000);
  ///////////////////////////////////////////
    u8g.firstPage();

    do{
        u8g.drawXBMP(21,0,85,64,pic1); 
    }while(u8g.nextPage());
  ///////////////////////////////////////////
   delay(2000);
  ///////////////////////////////////////////
      u8g.firstPage();

    do{
        u8g.drawXBMP(32,0,64,64,pic3); 
    }while(u8g.nextPage());
    
  ///////////////////////////////////////////
  pinMode(LED, OUTPUT);
  pinMode(LFD, OUTPUT);
  Serial.begin(9600);
  // 假如启动过程出现问题，提示用户启动失败
  //Serial.println("Enabling IRin");
  //Serial.println("Enabled IRin");
  irrecv.enableIRIn(); // Start the receiver
  digitalWrite(LED, LOW);
  digitalWrite(LFD, LOW);
}

void loop()   
{
  char por;
  if(irrecv.decode(&results)) //检查是否接收到红外遥控信号
  {   
      //Serial.println(results.value, HEX);
      
      if(results.value == 0xFFC23D) //检查是否接收到点亮LED指令代码（0xF7C03F）
      {          
          //Serial.println("Command Received: Turn On LED.");
          
          digitalWrite(LED, HIGH);
          digitalWrite(LFD, HIGH); 
          glib(por='n');
      } 
      
      if(results.value == 0xFF906F) //检查是否接收到熄灭LED指令代码（0xF740BF）
      {          
          //Serial.println("Command Received: Turn Off LED.");
          
          digitalWrite(LED, LOW);
          digitalWrite(LFD, LOW); 
          glib(por='f');
      }
      irrecv.resume(); //接收下一指令
  }
  
  delay(100);
}
